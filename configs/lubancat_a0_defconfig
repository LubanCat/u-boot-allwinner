## configs/lubancat_a0_defconfig
```kconfig
CONFIG_ARM=y
CONFIG_ARM_SMCCC=y
CONFIG_SYS_TEXT_BASE=0x4A000000
CONFIG_MACH_SUN50IW9=y
CONFIG_R_I2C0_ENABLE=y
CONFIG_DEFAULT_DEVICE_TREE="sun50iw9-lubancat-a0.dts"
CONFIG_DISTRO_DEFAULTS=y
# CONFIG_SYS_MALLOC_CLEAR_ON_INIT is not set
CONFIG_PHYS_64BIT=y
CONFIG_BOOTDELAY=1
CONFIG_CONSOLE_MUX=y
CONFIG_SUNXI_SERIAL=y
CONFIG_SUNXI_MAC=y
CONFIG_SUNXI_DRM_SUPPORT=y
CONFIG_SUNXI_CHECK_LIMIT_VERIFY=y
CONFIG_SUNXI_LIMIT_CPU_FREQ=y
CONFIG_CMD_FASTBOOT=y
CONFIG_CMD_SUNXI_NAND=y
CONFIG_CMD_EXT4_WRITE=y
CONFIG_CMD_SUNXI_TIMER=y
CONFIG_CMD_SUNXI_SPRITE=y
CONFIG_CMD_SUNXI_BURN=y
CONFIG_CMD_SUNXI_MEMTEST=y
CONFIG_OF_BOARD=y
CONFIG_ENV_IS_IN_FAT=y
CONFIG_CLK_SUNXI=y
CONFIG_SYS_I2C_SUNXI=y
CONFIG_SYS_SUNXI_R_I2C0_SPEED=400000
CONFIG_SYS_SUNXI_R_I2C0_SLAVE=0x34
CONFIG_AXP1530_SUNXI_I2C_SLAVE=0x36
CONFIG_MMC=y
CONFIG_AW_MTD_SPINAND=y
CONFIG_SUNXI_NO_PMIC=y
CONFIG_PWM_SUNXI_NEW=y
CONFIG_SUNXI_POWER=y
CONFIG_SUNXI_PMU=y
CONFIG_SUNXI_TRY_POWER_SPLY=y
CONFIG_AXP1530_POWER=y
CONFIG_SUNXI_NAND=y
CONFIG_SUNXI_UBIFS=y
CONFIG_SUNXI_SDMMC=y
CONFIG_SUNXI_USB=y
CONFIG_SUNXI_EFEX=y
CONFIG_SUNXI_BURN=y
CONFIG_LZMA=y
CONFIG_SUNXI_OVERLAY=y
CONFIG_SUNXI_SPRITE=y
CONFIG_SUNXI_SPRITE_CARTOON=y
```
